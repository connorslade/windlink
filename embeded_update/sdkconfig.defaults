## embeded_update/sdkconfig.defaults
```kconfig
CONFIG_COMPILER_OPTIMIZATION_SIZE=y
CONFIG_COMPILER_OPTIMIZATION_ASSERTIONS_DISABLE=y
CONFIG_LOG_DEFAULT_LEVEL_NONE=y
CONFIG_ESP_COREDUMP_ENABLE_TO_NONE=y
CONFIG_ESP_SYSTEM_PANIC_PRINT_HALT=y
CONFIG_LWIP_IPV6=n
CONFIG_BT_ENABLED=n
CONFIG_ESP_HTTP_CLIENT_ENABLE_HTTPS=n
CONFIG_WPA_11KV_SUPPORT=n
CONFIG_ESP_CONSOLE_NONE=y
CONFIG_BOOTLOADER_LOG_LEVEL_NONE=y
```
